#include "haili58.dtsi"

/ {
    kscan_dongle: kscan_dongle {
        compatible = "zmk,kscan-mock";
        columns = <0>;
        rows = <0>;
        events = <0>;
    };
};

&physical_layout_haili58 {
    kscan = <&kscan_dongle>;
};

